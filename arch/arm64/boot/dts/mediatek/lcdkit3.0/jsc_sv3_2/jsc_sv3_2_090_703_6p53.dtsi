/* Copyright (c) 2013, The Linux Foundation. All rights reserved.
 *
 * This program is free software; you can redistribute it and/or modify
 * it under the terms of the GNU General Public License version 2 and
 * only version 2 as published by the Free Software Foundation.
 *
 * This program is distributed in the hope that it will be useful,
 * but WITHOUT ANY WARRANTY; without even the implied warranty of
 * MERCHANTABILITY or FITNESS FOR A PARTICULAR PURPOSE.  See the
 * GNU General Public License for more details.
 */

/*-------------------------------------------------------------------------
 * This file is autogenerated file using gcdb parser. Please do not edit it.
 * Update input XML file to add a new entry or update variable in this file
 * VERSION = 1.1
 *-----------------------------------------------------------------------*/
&huawei_lcd_config {
	dsi_jsc_sv3_2_090_703_6p53: lcd_kit_jsc_sv3_2_090_703_6p53 {
		compatible = "090_703_6p53";
		lcd-kit,panel-name = "090_703 6.53' 1080 x 2400";
		lcd-kit,panel-type = <0x02>;
		lcd-kit,panel-xres = <1080>;
		lcd-kit,panel-yres = <2400>;
		lcd-kit,panel-width = <70>;
		lcd-kit,panel-height = <155>;
		lcd-kit,panel-enter-aod-cmds = <0x39 0x01 0x00 0x00 0x0a 0x00 0x03 0xF0 0x5A 0x5A
			0x39 0x01 0x00 0x00 0x0a 0x00 0x03 0xFC 0x5A 0x5A
			0x39 0x01 0x00 0x00 0x0a 0x00 0x03 0xB0 0x14 0xFE
			0x15 0x01 0x00 0x00 0x0a 0x00 0x02 0xFE 0x12
			0x05 0x01 0x00 0x00 0x0b 0x01 0x01 0x11
			0x15 0x01 0x00 0x00 0x0a 0x00 0x02 0xF2 0x03
			0x15 0x01 0x00 0x00 0x0b 0x01 0x02 0x35 0x00
			0x39 0x01 0x00 0x00 0x0a 0x00 0x03 0xF0 0x5A 0x5A
			0x39 0x01 0x00 0x00 0x0a 0x00 0x02 0xB0 0x02
			0x39 0x01 0x00 0x00 0x0a 0x00 0x02 0xC3 0x06
			0x39 0x01 0x00 0x00 0x0a 0x00 0x02 0xB0 0x14
			0x39 0x01 0x00 0x00 0x0a 0x00 0x02 0xC3 0x10
			0x39 0x01 0x00 0x00 0x0a 0x00 0x02 0xB0 0x28
			0x39 0x01 0x00 0x00 0x0a 0x00 0x03 0xC3 0x57 0x80
			0x39 0x01 0x00 0x00 0x0a 0x00 0x02 0xB0 0x49
			0x39 0x01 0x00 0x00 0x0a 0x00 0x02 0xC3 0x0A
			0x39 0x01 0x00 0x00 0x0a 0x00 0x02 0xB0 0x68
			0x39 0x01 0x00 0x00 0x0a 0x00 0x02 0xC3 0x79
			0x39 0x01 0x00 0x00 0x0a 0x00 0x02 0xF7 0x03
			0x39 0x01 0x00 0x00 0x0a 0x00 0x03 0xF0 0xA5 0xA5
			0x39 0x01 0x00 0x00 0x0a 0x00 0x03 0xF0 0x5A 0x5A
			0x39 0x01 0x00 0x00 0x0a 0x00 0x02 0xB0 0x01
			0x39 0x01 0x00 0x00 0x0a 0x00 0x07 0xF2 0x0B 0x15 0x26 0xA0 0x26 0xA0
			0x39 0x01 0x00 0x00 0x0a 0x00 0x03 0xF0 0xA5 0xA5
			0x39 0x01 0x00 0x00 0x0a 0x00 0x03 0xF0 0x5A 0x5A
			0x39 0x01 0x00 0x00 0x0a 0x00 0x02 0xB0 0x26
			0x39 0x01 0x00 0x00 0x0a 0x00 0x02 0xB5 0x98
			0x39 0x01 0x00 0x00 0x0a 0x00 0x02 0xB0 0x28
			0x39 0x01 0x00 0x00 0x0a 0x00 0x03 0xB5 0x80 0x98
			0x39 0x01 0x00 0x00 0x0a 0x00 0x02 0xB0 0x2B
			0x39 0x01 0x00 0x00 0x0a 0x00 0x03 0xB5 0x80 0x98
			0x39 0x01 0x00 0x00 0x0a 0x00 0x02 0xB0 0x2E
			0x39 0x01 0x00 0x00 0x0a 0x00 0x03 0xB5 0x80 0x98
			0x39 0x01 0x00 0x00 0x0a 0x00 0x02 0xB0 0x31
			0x39 0x01 0x00 0x00 0x0a 0x00 0x03 0xB5 0x80 0x98
			0x39 0x01 0x00 0x00 0x0a 0x00 0x02 0xB0 0x34
			0x39 0x01 0x00 0x00 0x0a 0x00 0x02 0xB5 0x80
			0x39 0x01 0x00 0x00 0x0a 0x00 0x02 0xB0 0x37
			0x39 0x01 0x00 0x00 0x0a 0x00 0x02 0xB5 0x14
			0x39 0x01 0x00 0x00 0x0a 0x00 0x02 0xB0 0x3A
			0x39 0x01 0x00 0x00 0x0a 0x00 0x03 0xB5 0x20 0x50
			0x39 0x01 0x00 0x00 0x0a 0x00 0x02 0xB0 0x3D
			0x39 0x01 0x00 0x00 0x0a 0x00 0x04 0xB5 0x14 0x20 0x50
			0x39 0x01 0x00 0x00 0x0a 0x00 0x02 0xB0 0x3D
			0x39 0x01 0x00 0x00 0x0a 0x00 0x04 0xB5 0x14 0x20 0x50
			0x39 0x01 0x00 0x00 0x0a 0x00 0x02 0xF7 0x03
			0x39 0x01 0x00 0x00 0x0a 0x01 0x2D 0x81 0x21 0x00 0xCB 0x12 0xC5 0x46 0x00 0x00 0x00 0x00 0x00 0x00 0x00 0x00 0x00 0x00 0x00 0x00 0x00 0x00 0x00 0x00 0x00 0x00 0x00 0x00 0x1B 0xC2 0x82 0xD8 0xF5 0x00 0x00 0x20 0x00 0x00 0x00 0xFF 0xFF 0xFF 0xFF 0xFF 0xFF 0x00
			0x39 0x01 0x00 0x00 0x0a 0x00 0x02 0xB0 0x06
			0x39 0x01 0x00 0x00 0x0a 0x00 0x02 0xFD 0x85
			0x15 0x01 0x00 0x00 0x0a 0x00 0x02 0x53 0x22
			0x39 0x01 0x00 0x00 0x0a 0x00 0x03 0xB0 0x14 0xFE
			0x39 0x01 0x00 0x00 0x0a 0x00 0x02 0xFE 0x10
			0x39 0x01 0x00 0x00 0x0a 0x00 0x03 0xB0 0x02 0xED
			0x15 0x01 0x00 0x00 0x69 0x01 0x02 0xED 0x02>;
		lcd-kit,panel-exit-aod-cmds = <0x05 0x01 0x00 0x00 0x22 0x01 0x01 0x28
			0x15 0x01 0x00 0x00 0x0a 0x00 0x02 0x53 0x20
			0x05 0x01 0x00 0x00 0x0a 0x00 0x01 0x29>;
		lcd-kit,panel-aod-high-brightness-cmds = <0x15 0x01 0x00 0x00 0x0a 0x00 0x02 0x53 0x22
			0x05 0x01 0x00 0x00 0x0a 0x00 0x01 0x29
			0x15 0x01 0x00 0x00 0x0a 0x00 0x02 0xF2 0x0F
			0x39 0x01 0x00 0x00 0x0a 0x00 0x03 0xF0 0xA5 0xA5
			0x39 0x01 0x00 0x00 0x0a 0x00 0x03 0xFC 0xA5 0xA5>;
		lcd-kit,panel-aod-low-brightness-cmds = <0x15 0x01 0x00 0x00 0x0a 0x00 0x02 0x53 0x23
			0x05 0x01 0x00 0x00 0x0a 0x00 0x01 0x29
			0x15 0x01 0x00 0x00 0x0a 0x00 0x02 0xF2 0x0F
			0x39 0x01 0x00 0x00 0x0a 0x00 0x03 0xF0 0xA5 0xA5
			0x39 0x01 0x00 0x00 0x0a 0x00 0x03 0xFC 0xA5 0xA5>;
		lcd-kit,panel-aod-on-one-bit-cmds = <0x39 0x01 0x00 0x00 0x0a 0x00 0x03 0xF0 0x5A 0x5A
			0x39 0x01 0x00 0x00 0x0a 0x00 0x03 0xFC 0x5A 0x5A
			0x39 0x01 0x00 0x00 0x0a 0x00 0x03 0xB0 0x14 0xFE
			0x15 0x01 0x00 0x00 0x0a 0x00 0x02 0xFE 0x12
			0x05 0x01 0x00 0x00 0x0b 0x01 0x01 0x11
			0x15 0x01 0x00 0x00 0x0a 0x00 0x02 0xF2 0x03
			0x15 0x01 0x00 0x00 0x0b 0x01 0x02 0x35 0x00
			0x39 0x01 0x00 0x00 0x0a 0x00 0x03 0xF0 0x5A 0x5A
			0x39 0x01 0x00 0x00 0x0a 0x00 0x02 0xB0 0x02
			0x39 0x01 0x00 0x00 0x0a 0x00 0x02 0xC3 0x06
			0x39 0x01 0x00 0x00 0x0a 0x00 0x02 0xB0 0x14
			0x39 0x01 0x00 0x00 0x0a 0x00 0x02 0xC3 0x10
			0x39 0x01 0x00 0x00 0x0a 0x00 0x02 0xB0 0x28
			0x39 0x01 0x00 0x00 0x0a 0x00 0x03 0xC3 0x57 0x80
			0x39 0x01 0x00 0x00 0x0a 0x00 0x02 0xB0 0x49
			0x39 0x01 0x00 0x00 0x0a 0x00 0x02 0xC3 0x0A
			0x39 0x01 0x00 0x00 0x0a 0x00 0x02 0xB0 0x68
			0x39 0x01 0x00 0x00 0x0a 0x00 0x02 0xC3 0x79
			0x39 0x01 0x00 0x00 0x0a 0x00 0x02 0xF7 0x03
			0x39 0x01 0x00 0x00 0x0a 0x00 0x03 0xF0 0xA5 0xA5
			0x39 0x01 0x00 0x00 0x0a 0x00 0x03 0xF0 0x5A 0x5A
			0x39 0x01 0x00 0x00 0x0a 0x00 0x02 0xB0 0x01
			0x39 0x01 0x00 0x00 0x0a 0x00 0x07 0xF2 0x0B 0x15 0x26 0xA0 0x26 0xA0
			0x39 0x01 0x00 0x00 0x0a 0x00 0x03 0xF0 0xA5 0xA5
			0x39 0x01 0x00 0x00 0x0a 0x00 0x03 0xF0 0x5A 0x5A
			0x39 0x01 0x00 0x00 0x0a 0x00 0x02 0xB0 0x26
			0x39 0x01 0x00 0x00 0x0a 0x00 0x02 0xB5 0x98
			0x39 0x01 0x00 0x00 0x0a 0x00 0x02 0xB0 0x28
			0x39 0x01 0x00 0x00 0x0a 0x00 0x03 0xB5 0x80 0x98
			0x39 0x01 0x00 0x00 0x0a 0x00 0x02 0xB0 0x2B
			0x39 0x01 0x00 0x00 0x0a 0x00 0x03 0xB5 0x80 0x98
			0x39 0x01 0x00 0x00 0x0a 0x00 0x02 0xB0 0x2E
			0x39 0x01 0x00 0x00 0x0a 0x00 0x03 0xB5 0x80 0x98
			0x39 0x01 0x00 0x00 0x0a 0x00 0x02 0xB0 0x31
			0x39 0x01 0x00 0x00 0x0a 0x00 0x03 0xB5 0x80 0x98
			0x39 0x01 0x00 0x00 0x0a 0x00 0x02 0xB0 0x34
			0x39 0x01 0x00 0x00 0x0a 0x00 0x02 0xB5 0x80
			0x39 0x01 0x00 0x00 0x0a 0x00 0x02 0xB0 0x37
			0x39 0x01 0x00 0x00 0x0a 0x00 0x02 0xB5 0x14
			0x39 0x01 0x00 0x00 0x0a 0x00 0x02 0xB0 0x3A
			0x39 0x01 0x00 0x00 0x0a 0x00 0x03 0xB5 0x20 0x50
			0x39 0x01 0x00 0x00 0x0a 0x00 0x02 0xB0 0x3D
			0x39 0x01 0x00 0x00 0x0a 0x00 0x04 0xB5 0x14 0x20 0x50
			0x39 0x01 0x00 0x00 0x0a 0x00 0x02 0xB0 0x3D
			0x39 0x01 0x00 0x00 0x0a 0x00 0x04 0xB5 0x14 0x20 0x50
			0x39 0x01 0x00 0x00 0x0a 0x00 0x02 0xF7 0x03
			0x39 0x01 0x00 0x00 0x0a 0x01 0x2D 0x81 0x21 0x00 0xCB 0x12 0xC5 0x46 0x00 0x00 0x00 0x00 0x00 0x00 0x00 0x00 0x00 0x00 0x00 0x00 0x00 0x00 0x00 0x00 0x00 0x00 0x00 0x00 0x1B 0xC2 0x82 0xD8 0xF5 0x00 0x00 0x20 0x00 0x00 0x00 0xFF 0xFF 0xFF 0xFF 0xFF 0xFF 0x00
			0x39 0x01 0x00 0x00 0x0a 0x00 0x02 0xB0 0x06
			0x39 0x01 0x00 0x00 0x0a 0x00 0x02 0xFD 0x85
			0x15 0x01 0x00 0x00 0x0a 0x00 0x02 0x53 0x22
			0x39 0x01 0x00 0x00 0x0a 0x00 0x03 0xB0 0x14 0xFE
			0x39 0x01 0x00 0x00 0x0a 0x00 0x02 0xFE 0x10
			0x39 0x01 0x00 0x00 0x0a 0x00 0x03 0xB0 0x02 0xED
			0x15 0x01 0x00 0x00 0x69 0x01 0x02 0xED 0x02>;
		lcd-kit,panel-aod-on-two-bit-cmds = <0x39 0x01 0x00 0x00 0x0a 0x00 0x03 0xF0 0x5A 0x5A
			0x39 0x01 0x00 0x00 0x0a 0x00 0x03 0xFC 0x5A 0x5A
			0x39 0x01 0x00 0x00 0x0a 0x00 0x03 0xB0 0x14 0xFE
			0x15 0x01 0x00 0x00 0x0a 0x00 0x02 0xFE 0x12
			0x05 0x01 0x00 0x00 0x0b 0x01 0x01 0x11
			0x15 0x01 0x00 0x00 0x0a 0x00 0x02 0xF2 0x03
			0x15 0x01 0x00 0x00 0x0b 0x01 0x02 0x35 0x00
			0x39 0x01 0x00 0x00 0x0a 0x00 0x03 0xF0 0x5A 0x5A
			0x39 0x01 0x00 0x00 0x0a 0x00 0x02 0xB0 0x02
			0x39 0x01 0x00 0x00 0x0a 0x00 0x02 0xC3 0x06
			0x39 0x01 0x00 0x00 0x0a 0x00 0x02 0xB0 0x14
			0x39 0x01 0x00 0x00 0x0a 0x00 0x02 0xC3 0x10
			0x39 0x01 0x00 0x00 0x0a 0x00 0x02 0xB0 0x28
			0x39 0x01 0x00 0x00 0x0a 0x00 0x03 0xC3 0x57 0x80
			0x39 0x01 0x00 0x00 0x0a 0x00 0x02 0xB0 0x49
			0x39 0x01 0x00 0x00 0x0a 0x00 0x02 0xC3 0x0A
			0x39 0x01 0x00 0x00 0x0a 0x00 0x02 0xB0 0x68
			0x39 0x01 0x00 0x00 0x0a 0x00 0x02 0xC3 0x79
			0x39 0x01 0x00 0x00 0x0a 0x00 0x02 0xF7 0x03
			0x39 0x01 0x00 0x00 0x0a 0x00 0x03 0xF0 0xA5 0xA5
			0x39 0x01 0x00 0x00 0x0a 0x00 0x03 0xF0 0x5A 0x5A
			0x39 0x01 0x00 0x00 0x0a 0x00 0x02 0xB0 0x01
			0x39 0x01 0x00 0x00 0x0a 0x00 0x07 0xF2 0x0B 0x15 0x26 0xA0 0x26 0xA0
			0x39 0x01 0x00 0x00 0x0a 0x00 0x03 0xF0 0xA5 0xA5
			0x39 0x01 0x00 0x00 0x0a 0x00 0x03 0xF0 0x5A 0x5A
			0x39 0x01 0x00 0x00 0x0a 0x00 0x02 0xB0 0x26
			0x39 0x01 0x00 0x00 0x0a 0x00 0x02 0xB5 0x98
			0x39 0x01 0x00 0x00 0x0a 0x00 0x02 0xB0 0x28
			0x39 0x01 0x00 0x00 0x0a 0x00 0x03 0xB5 0x80 0x98
			0x39 0x01 0x00 0x00 0x0a 0x00 0x02 0xB0 0x2B
			0x39 0x01 0x00 0x00 0x0a 0x00 0x03 0xB5 0x80 0x98
			0x39 0x01 0x00 0x00 0x0a 0x00 0x02 0xB0 0x2E
			0x39 0x01 0x00 0x00 0x0a 0x00 0x03 0xB5 0x80 0x98
			0x39 0x01 0x00 0x00 0x0a 0x00 0x02 0xB0 0x31
			0x39 0x01 0x00 0x00 0x0a 0x00 0x03 0xB5 0x80 0x98
			0x39 0x01 0x00 0x00 0x0a 0x00 0x02 0xB0 0x34
			0x39 0x01 0x00 0x00 0x0a 0x00 0x02 0xB5 0x80
			0x39 0x01 0x00 0x00 0x0a 0x00 0x02 0xB0 0x37
			0x39 0x01 0x00 0x00 0x0a 0x00 0x02 0xB5 0x14
			0x39 0x01 0x00 0x00 0x0a 0x00 0x02 0xB0 0x3A
			0x39 0x01 0x00 0x00 0x0a 0x00 0x03 0xB5 0x20 0x50
			0x39 0x01 0x00 0x00 0x0a 0x00 0x02 0xB0 0x3D
			0x39 0x01 0x00 0x00 0x0a 0x00 0x04 0xB5 0x14 0x20 0x50
			0x39 0x01 0x00 0x00 0x0a 0x00 0x02 0xB0 0x3D
			0x39 0x01 0x00 0x00 0x0a 0x00 0x04 0xB5 0x14 0x20 0x50
			0x39 0x01 0x00 0x00 0x0a 0x00 0x02 0xF7 0x03
			0x39 0x01 0x00 0x00 0x0a 0x01 0x2D 0x81 0x21 0x0F 0xC6 0x12 0xC5 0x00 0x00 0x00 0x00 0x00 0x00 0x00 0x00 0x00 0x00 0x00 0x00 0x00 0x00 0x00 0x00 0x00 0x00 0x00 0x00 0x00 0x1B 0xC2 0x82 0xD8 0xF5 0x00 0x40 0x20 0x00 0x00 0x00 0xFF 0xFF 0xFF 0xFF 0xFF 0xFF 0x00
			0x39 0x01 0x00 0x00 0x0a 0x00 0x02 0xB0 0x06
			0x39 0x01 0x00 0x00 0x0a 0x00 0x02 0xFD 0x85
			0x15 0x01 0x00 0x00 0x0a 0x00 0x02 0x53 0x22
			0x39 0x01 0x00 0x00 0x0a 0x00 0x03 0xB0 0x14 0xFE
			0x39 0x01 0x00 0x00 0x0a 0x00 0x02 0xFE 0x10
			0x39 0x01 0x00 0x00 0x0a 0x00 0x03 0xB0 0x02 0xED
			0x15 0x01 0x00 0x00 0x69 0x01 0x02 0xED 0x02>;
		lcd-kit,panel-on-cmds = <0x05 0x01 0x00 0x00 0x14 0x01 0x01 0x11
			0x15 0x01 0x00 0x00 0x0a 0x00 0x02 0x35 0x00
			0x39 0x01 0x00 0x00 0x0a 0x00 0x03 0xF0 0x5A 0x5A
			0x39 0x01 0x00 0x00 0x0a 0x00 0x03 0xFC 0x5A 0x5A
			0x39 0x01 0x00 0x00 0x2a 0x00 0x0D 0xED 0x00 0x01 0x00 0x40 0x04 0x08 0xA8 0x84 0x4A 0x73 0x02 0x0A
			0x39 0x01 0x00 0x00 0x0a 0x00 0x03 0xB0 0x02 0xED
			0x15 0x01 0x00 0x00 0x0a 0x00 0x02 0xED 0x02
			0x15 0x01 0x00 0x00 0x66 0x01 0x02 0x53 0x20
			0x15 0x01 0x00 0x00 0x0a 0x00 0x02 0xB0 0x01
			0x15 0x01 0x00 0x00 0x0a 0x00 0x02 0xB3 0x4B
			0x39 0x01 0x00 0x00 0x0a 0x00 0x03 0xF0 0xA5 0xA5
			0x39 0x01 0x00 0x00 0x0a 0x00 0x03 0xFC 0xA5 0xA5
			0x05 0x01 0x00 0x00 0x0a 0x00 0x01 0x29>;
		lcd-kit,panel-on-cmds-state = "dsi_lp_mode";
		lcd-kit,panel-off-cmds = <0x05 0x01 0x00 0x00 0x14 0x01 0x01 0x28
			0x05 0x01 0x00 0x00 0x64 0x01 0x01 0x10>;
		lcd-kit,panel-off-cmds-state = "dsi_lp_mode";
		lcd-kit,backlight-cmds = <0x39 0x01 0x00 0x00 0x00 0x00 0x03 0x51 0x00 0x00>;
		lcd-kit,panel-hbm-elvss-read-cmds = <0x39 0x01 0x00 0x00 0x0a 0x00 0x03 0xF0 0x5A 0x5A
			0x39 0x01 0x00 0x00 0x0a 0x00 0x03 0xB0 0x05 0xB3
			0x39 0x01 0x00 0x00 0x0a 0x00 0x02 0xB3 0x07
			0x39 0x01 0x00 0x00 0x0a 0x00 0x03 0xF0 0xA5 0xA5>;
		lcd-kit,tp-color-cmds = <0x06 0x01 0x00 0x00 0x0a 0x00 0x01 0xdc>;
		lcd-kit,esd-reg-cmds = <0x06 0x01 0x00 0x00 0x0a 0x00 0x01 0x0a>;
		lcd-kit,esd-value = <0x9f>;
		lcd-kit,check-reg-cmds = <0x06 0x01 0x00 0x00 0x0a 0x00 0x01 0x0a>;
		lcd-kit,pcd-check-reg-cmds = <0x0C>;
		lcd-kit,check-reg-value = <0x9f>;
		lcd-kit,pcd-check-reg-value = <0x0C>;
		lcd-kit,barcode-2d-cmds = <0x06 0x01 0x00 0x00 0x0a 0x00 0x04 0xA1 0x00 0x00 0x00
				0x15 0x01 0x00 0x00 0x0a 0x00 0x02 0xB0 0x04
				0x06 0x01 0x00 0x00 0x0a 0x00 0x04 0xA1 0x00 0x00 0x00
				0x15 0x01 0x00 0x00 0x0a 0x00 0x02 0xB0 0x08
				0x06 0x01 0x00 0x00 0x0a 0x00 0x04 0xA1 0x00 0x00 0x00
				0x15 0x01 0x00 0x00 0x0a 0x00 0x02 0xB0 0x0C
				0x06 0x01 0x00 0x00 0x0a 0x00 0x04 0xA1 0x00 0x00 0x00>;
		lcd-kit,panel-bl-maxnit-command = <0x06 0x01 0x00 0x00 0x0a 0x00 0x01 0xdb>;
		lcd-kit,panel-bl-maxnit-command-state = "dsi_lp_mode";
		lcd-kit,dirty-region-cmds = <>;
		lcd-kit,hbm-enter-cmds = <0x15 0x01 0x00 0x00 0x0a 0x00 0x02 0x53 0xE8
			0x39 0x01 0x00 0x00 0x0a 0x00 0x03 0x51 0x07 0xFF>;
		lcd-kit,hbm-enter-no-dim-cmds = <0x15 0x01 0x00 0x00 0x0a 0x00 0x02 0x53 0xE0
			0x39 0x01 0x00 0x00 0x0a 0x00 0x03 0x51 0x07 0xFF>;
		lcd-kit,hbm-fp-enter-cmds = <0x15 0x01 0x00 0x00 0x0a 0x00 0x02 0x53 0xE0
			0x39 0x01 0x00 0x00 0x0a 0x00 0x03 0x51 0x07 0xFF>;
		lcd-kit,enter-dim-cmds = <0x15 0x01 0x00 0x00 0x0a 0x00 0x02 0x53 0x28>;
		lcd-kit,exit-dim-cmds = <0x15 0x01 0x00 0x00 0x0a 0x00 0x02 0x53 0x20>;
		lcd-kit,start-pcd-check-cmds = <0x39 0x01 0x00 0x00 0x0a 0x00 0x03 0xF0 0x5A 0x5A
			0x15 0x01 0x00 0x00 0x0a 0x00 0x02 0xEA 0x48
			0x39 0x01 0x00 0x00 0x0a 0x00 0x03 0xF0 0xA5 0xA5>;
		lcd-kit,pcd-read-cmds = <0x06 0x01 0x00 0x00 0x0a 0x00 0x01 0xE7>;
		lcd-kit,pcd-read-cmds-state  = "dsi_hs_mode";
		lcd-kit,ap-aod-support = <1>;
		lcd-kit,ap-aod-doze-delay = <3>;
		lcd-kit,aod-need-reset = <1>;
		lcd-kit,aod-no-need-init = <1>;
		lcd-kit,te-interval-time-us = <16667>;
		lcd-kit,fphbm-entry-delay-afterBL = <90000>;
		lcd-kit,hbm-support = <1>;
		lcd-kit,hbm-special-bit-ctrl-support = <1>;
		lcd-kit,hbm-elvss-dim-support = <1>;
		lcd-kit,hbm-elvss-dim-cmd-delay = <0>;
		lcd-kit,hbm-fp-support = <1>;
		lcd-kit,hbm-level-max = <16>;
		lcd-kit,panel-lcm-type = <2>;
		lcd-kit,panel-ldi-dsi-mode = <1>;
		lcd-kit,panel-dsi-switch-mode = <0>;
		lcd-kit,panel-dsi-switch-mode-en = <0>;
		lcd-kit,panel-ldi-trans-seq = <0>;
		lcd-kit,panel-ldi-data-padding = <0>;
		lcd-kit,panel-ldi-packet-size = <256>;
		lcd-kit,panel-ldi-ps = <2>;
		lcd-kit,panel-vfp-lp = <0>;
		lcd-kit,panel-fbk-div = <1>;
		lcd-kit,panel-orientation = <1>;
		lcd-kit,panel-bpp = <2>;
		lcd-kit,panel-bgr-fmt = <0>;
		lcd-kit,panel-cmd-type = <8>;
		lcd-kit,panel-pxl-clk = <0>;
		lcd-kit,panel-pxl-clk-div = <0>;
		lcd-kit,panel-data-rate = <1124>;
		lcd-kit,mipi-lane-nums = <4>;
		lcd-kit,h-back-porch = <22>;
		lcd-kit,h-front-porch = <72>;
		lcd-kit,h-pulse-width = <16>;
		lcd-kit,project-id-support = <0>;
		lcd-kit,default-project-id = "B1859U0900";
		lcd-kit,v-back-porch = <7>;
		lcd-kit,v-front-porch = <22>;
		lcd-kit,v-pulse-width = <3>;
		lcd-kit,mipi-clk-post-adjust = <0>;
		lcd-kit,mipi-lp11-flag = <0>;
		lcd-kit,esd-support = <1>;
		lcd-kit,skip-poweron-esd-check = <1>;
		lcd-kit,again-esd-check-delay = <140>;
		lcd-kit,esd-recovery-bl-support = <1>;
		lcd-kit,tp-color-support = <1>;
		lcd-kit,vci-name = "VFP";
		lcd-kit,lcd-vci = <1 1 3000000>;
		lcd-kit,lcd-iovcc = <2 136 1800000>;
		lcd-kit,lcd-vsp = <0 0 0>;
		lcd-kit,lcd-vsn = <0 0 0>;
		lcd-kit,lcd-reset = <2 86 0>;
		lcd-kit,power-on-stage = <2 1 2
				1 1 12
				5 2 1
				5 1 7
				7 1 0
				6 1 0
				8 1 0>;
		lcd-kit,lp-on-stage = <0 0 0>;
		lcd-kit,hs-on-stage = <0 0 0>;
		lcd-kit,hs-off-stage = <0 0 0>;
		lcd-kit,lp-off-stage = <0 0 0>;
		lcd-kit,power-off-stage = <7 0 0
				6 0 0
				8 0 0
				0 0 0
				5 0 10
				1 0 1
				2 0 1>;
		lcd-kit,pt-support = <1>;
		lcd-kit,panel-density = <320>;
		lcd-kit,ssc-disable = <1>;
		lcd-kit,inversion-support = <0>;
		lcd-kit,check-reg-support = <0>;
		lcd-kit,panel-bl-min = <24>;
		lcd-kit,panel-bl-max = <2047>;
		lcd-kit,panel-bl-max-nit = <450>;
		lcd-kit,panel-bl-boot = <255>;
		lcd-kit,panel-idle-mode-support = <1>;
		lcd-kit,mipi-non-continue-enable = <1>;
		lcd-kit,panel-getblmaxnit-type = <1>;
		lcd-kit,panel-bl-ic-ctrl-type = <7>;
		lcd-kit,panel-bias-ic-ctrl-type = <0>;
		lcd-kit,oem-info-support = <1>;
		lcd-kit,oem-barcode-2d-support = <1>;
		lcd-kit,oem-barcode-2d-num-offset = <0>;
		lcd-kit,panel-on-always-reset = <1>;
		lcd-kit,panel-pre-power-off = <1>;
		lcd-kit,panel-gpio-offset = <300>;
		lcd-kit,backlight-order = <0>;
		lcd-kit,fps-support = <0>;
		lcd-kit,dsc-enable = <0>;
		lcd-kit,dsc-ver = <17>;
		lcd-kit,dsc-slice-mode = <1>;
		lcd-kit,dsc-rgb-swap = <0>;
		lcd-kit,dsc-cfg = <34>;
		lcd-kit,dsc-rct-on = <1>;
		lcd-kit,dsc-bit-per-channel = <8>;
		lcd-kit,dsc-line-buf-depth = <9>;
		lcd-kit,dsc-bp-enable = <1>;
		lcd-kit,dsc-bit-per-pixel = <128>;
		lcd-kit,dsc-pic-height = <2400>;
		lcd-kit,dsc-pic-width = <1080>;
		lcd-kit,dsc-slice-height = <20>;
		lcd-kit,dsc-slice-width = <540>;
		lcd-kit,dsc-chunk-size = <540>;
		lcd-kit,dsc-xmit-delay = <512>;
		lcd-kit,dsc-dec-delay = <526>;
		lcd-kit,dsc-scale-value = <32>;
		lcd-kit,dsc-increment-interval = <488>;
		lcd-kit,dsc-decrement-interval = <7>;
		lcd-kit,dsc-line-bpg-offset = <12>;
		lcd-kit,dsc-nfl-bpg-offset = <1294>;
		lcd-kit,dsc-slice-bpg-offset = <1302>;
		lcd-kit,dsc-initial-offset = <6144>;
		lcd-kit,dsc-final-offset = <4336>;
		lcd-kit,dsc-flatness-minqp = <3>;
		lcd-kit,dsc-flatness-maxqp = <12>;
		lcd-kit,dsc-rc-model-size = <8192>;
		lcd-kit,dsc-rc-edge-factor = <6>;
		lcd-kit,dsc-rc-quant-incr-limit0 = <11>;
		lcd-kit,dsc-rc-quant-incr-limit1 = <11>;
		lcd-kit,dsc-rc-tgt-offset-hi = <3>;
		lcd-kit,dsc-rc-tgt-offset-lo = <3>;
		lcd-kit,vetical-refresh = <60>;
		lcd-kit,quickly-sleep-out-support = <0>;
		lcd-kit,quickly-sleep-out-interval = <0>;
		lcd-kit,mipi-hop-h-back-porch = <10>;
		lcd-kit,mipi-hop-h-front-porch = <32>;
		lcd-kit,mipi-hop-h-pulse-width = <10>;
		lcd-kit,mipi-hop-v-back-porch = <60>;
		lcd-kit,mipi-hop-v-front-porch = <14>;
		lcd-kit,mipi-hop-v-pulse-width = <30>;
		lcd-kit,mipi-hop-lp-v-front-porch = <14>;
		lcd-kit,Does-lcd-poweron-tp = <0>;
		lcd-kit,mipi-hop-support = <0>;
		lcd-kit,mipi-read-gerneric = <1>;
		lcd-kit,rgbw-support = <0>;
		lcd-kit,imax-lcd-luminance = <500>;
		lcd-kit,imin-lcd-luminance = <3>;
		lcd-kit,panel-blmaxnit-min-value = <400>;
		lcd-kit,hbm-en-times = <0>;
		lcd-kit,hbm-dis-times = <0>;
		lcd-kit,sn-code-support = <1>;
		lcd-kit,panel-round-corner-enable = <0>;
		lcd-kit,panel-round-corner-full-content = <0>;
		lcd-kit,panel-round-corner-h = <201>;
		lcd-kit,panel-round-corner-h-bot = <201>;
		lcd-kit,panel-round-corner-top-rc-pattern = <>;
    };
};