## drivers/huawei_platform/audio/Kconfig
```kconfig
menu "Audio configuration"
config HUAWEI_AUDIO
        bool "Audio support"
        default n
        select REGMAP_I2C
        help
          Enable support for audio
if HUAWEI_AUDIO
source "drivers/huawei_platform/audio/tfa9894/Kconfig"
source "drivers/huawei_platform/audio/aw88264/Kconfig"
source "drivers/huawei_platform/audio/fs1894/Kconfig"
source "drivers/huawei_platform/audio/tfa98xx/Kconfig"
source "drivers/huawei_platform/audio/tfa98xxa/Kconfig"
source "drivers/huawei_platform/audio/cs35lxx/Kconfig"
source "drivers/huawei_platform/audio/hs_auto_calib/Kconfig"
source "drivers/huawei_platform/audio/ana_hs_extern_ops/Kconfig"
endif # if HUAWEI_AUDIO
endmenu
```

## drivers/huawei_platform/audio/tfa98xxa/Kconfig
```kconfig
#
# Misc strange devices
#
config TFA98XXA
    bool "Goodix TFA98XXA smartpa misc driver"
    default n
```

## drivers/huawei_platform/power/Kconfig
```kconfig
source "drivers/huawei_platform/power/charger/Kconfig"
source "drivers/huawei_platform/power/uscp/Kconfig"
source "drivers/huawei_platform/power/pid_socket/Kconfig"
source "drivers/huawei_platform/power/wireless/Kconfig"
source "drivers/huawei_platform/power/hardware_monitor/Kconfig"
source "drivers/huawei_platform/power/hardware_ic/Kconfig"
source "drivers/huawei_platform/power/common_module/Kconfig"
source "drivers/huawei_platform/power/battery/Kconfig"
source "drivers/huawei_platform/power/factory/Kconfig"
source "drivers/huawei_platform/power/proxy/Kconfig"
```

## drivers/huawei_platform/power/factory/Kconfig
```kconfig
#
# huawei power factory
#

config HW_POWER_FACTORY
        bool "power_factory"
        default n
```

## drivers/huawei_platform/power/hardware_ic/fuel_gauge/Kconfig
```kconfig
#
# fuel gauge ic drivers
#
source "drivers/huawei_platform/power/hardware_ic/fuel_gauge/rt9426/Kconfig"

config FUEL_GAUGE
	bool "fuel gauge"
	default n
	help
	  Say Y here to enable fuel gauge.
```

## drivers/hwpower/Kconfig
```kconfig
#
# huawei power common drivers
#

source "drivers/hwpower/cc_common_module/Kconfig"
source "drivers/hwpower/cc_adapter/Kconfig"
source "drivers/hwpower/cc_hardware_ic/Kconfig"
source "drivers/hwpower/cc_hardware_monitor/Kconfig"
source "drivers/hwpower/cc_hardware_channel/Kconfig"
source "drivers/hwpower/cc_wireless/Kconfig"
source "drivers/hwpower/cc_battery/Kconfig"
```

## drivers/hwpower/cc_hardware_ic/Kconfig
```kconfig
#
# huawei hardware ic drivers
#

source "drivers/hwpower/cc_hardware_ic/coul/Kconfig"
source "drivers/hwpower/cc_hardware_ic/buck_boost/Kconfig"
source "drivers/hwpower/cc_hardware_ic/charge_pump/Kconfig"
source "drivers/hwpower/cc_hardware_ic/boost_5v/Kconfig"
```

## drivers/hwpower/cc_hardware_monitor/Kconfig
```kconfig
#
# huawei hardware monitor drivers
#

source "drivers/hwpower/cc_hardware_monitor/water_detect/Kconfig"
source "drivers/hwpower/cc_hardware_monitor/soc_control/Kconfig"
source "drivers/hwpower/cc_hardware_monitor/bat_heating/Kconfig"
source "drivers/hwpower/cc_hardware_monitor/temp_control/Kconfig"
source "drivers/hwpower/cc_hardware_monitor/btb_check/Kconfig"
source "drivers/hwpower/cc_hardware_monitor/ffc_control/Kconfig"
```

## drivers/misc/mediatek/nfc/Kconfig
```kconfig
config NFC_ST21NFC
	tristate "ST21NFC driver"
	depends on I2C
	help
	  ST21NFC driver.

config MTK_NFC_CLKBUF_ENABLE
	tristate "Enable clock buffer for NFC"
	help
	  Enable clock buffer from PMIC for NFC.
```
